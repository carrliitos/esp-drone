## sdkconfig.defaults
```kconfig
CONFIG_ESP32_PHY_MAX_WIFI_TX_POWER=20
CONFIG_ESP32_PHY_MAX_TX_POWER=20

CONFIG_FREERTOS_UNICORE=n
CONFIG_FREERTOS_NO_AFFINITY=0x7FFFFFFF
CONFIG_FREERTOS_CORETIMER_0=y
CONFIG_FREERTOS_OPTIMIZED_SCHEDULER=y
CONFIG_FREERTOS_HZ=1000
CONFIG_FREERTOS_SUPPORT_STATIC_ALLOCATION=y
CONFIG_FREERTOS_USE_STATS_FORMATTING_FUNCTIONS=y
CONFIG_FREERTOS_IDLE_TASK_STACKSIZE=2048
CONFIG_FREERTOS_ISR_STACKSIZE=2048
CONFIG_FREERTOS_ENABLE_BACKWARD_COMPATIBILITY=y

CONFIG_COMPILER_OPTIMIZATION_PERF=y
CONFIG_COMPILER_OPTIMIZATION_ASSERTIONS_ENABLE=y
CONFIG_COMPILER_STACK_CHECK_MODE_NONE=y

CONFIG_FREERTOS_TIMER_TASK_STACK_DEPTH=4096
CONFIG_ESPTOOLPY_FLASHMODE_QIO=y
CONFIG_ESPTOOLPY_FLASHFREQ_80M=y

CONFIG_FREERTOS_VTASKLIST_INCLUDE_COREID=y
CONFIG_FREERTOS_USE_TRACE_FACILITY=y
CONFIG_FREERTOS_GENERATE_RUN_TIME_STATS=y

CONFIG_WIFI_BASE_SSID="SPUD1"

#
# Original sensors config
#
CONFIG_I2C0_PIN_SDA=11
CONFIG_I2C0_PIN_SCL=10
CONFIG_I2C1_PIN_SDA=40
CONFIG_I2C1_PIN_SCL=41
CONFIG_SPI_PIN_MISO=37
CONFIG_SPI_PIN_MOSI=35
CONFIG_SPI_PIN_CLK=36
CONFIG_SPI_PIN_CS0=34
CONFIG_MPU_PIN_INT=12
CONFIG_ADC1_PIN=2
CONFIG_EXT01_PIN=1
# end of sensors config
```
